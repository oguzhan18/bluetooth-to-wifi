## firmware/esp32/main/Kconfig.projbuild
```kconfig
menu "Bluetooth-to-WiFi"

config BTW_WIFI_SSID string "WiFi SSID"
    default "myssid"

config BTW_WIFI_PASSWORD
    string "WiFi password"
    default "mypass"

config BTW_HTTP_URL
    string "Downstream HTTP URL (POST JSON)"
    default "http://192.168.1.10:8765/v1/ingest"

config BTW_BRIDGE_ID
    string "Bridge id"
    default "esp32-edge"

config BTW_BLE_TARGET_ADDR
    string "Target BLE address (AA:BB:CC:DD:EE:FF)"
    default "00:00:00:00:00:00"

config BTW_SERVICE_UUID
    string "Target service UUID (optional)"
    default ""

config BTW_CHAR_UUID
    string "Target characteristic UUID (notify)"
    default "00002a6e-0000-1000-8000-00805f9b34fb"

endmenu
```

## firmware/esp32/sdkconfig.defaults
```kconfig
CONFIG_ESP_WIFI_STA=y
CONFIG_ESP_WIFI_SOFTAP=n
CONFIG_BT_ENABLED=y
CONFIG_BT_NIMBLE_ENABLED=y
CONFIG_BT_NIMBLE_ROLE_CENTRAL=y
CONFIG_BT_NIMBLE_ROLE_OBSERVER=y
CONFIG_BT_NIMBLE_MAX_CONNECTIONS=3
CONFIG_COMPILER_OPTIMIZATION_SIZE=y
```
